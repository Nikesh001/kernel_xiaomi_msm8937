qcom,2336567_wingtech_s88537a1coslight_4000mah_averaged_masterslave_mar3rd2016 {
	qcom,max-voltage-uv = <0x432380>;
	qcom,nom-batt-capacity-mah = <0x1004>;
	qcom,batt-id-kohm = <0x64>;
	qcom,battery-beta = <0x109a>;
	qcom,battery-type = "qrd_msm8937_Coslight_4100mah";
	qcom,chg-rslow-comp-c1 = <0x37d1f3>;
	qcom,chg-rslow-comp-c2 = <0x5baa3b>;
	qcom,chg-rs-to-rslow = <0x10a654>;
	qcom,chg-rslow-comp-thr = <0xb2>;
	qcom,checksum = <0xa765>;
	qcom,gui-version = "PMI8950GUI - 2.0.0.15";
	qcom,fg-profile-data = <0xe183e07c 0x31818877 0x62831c74 0x4e896094 0x4082a698 0x79b608c2 0x52170788 0xa7ef781 0x737c3683 0x40790886 0x9d816b82 0x6b98d0b6 0x25c35e15 0x32104259 0x1470eefc 0x436dc44 0xde3b0000 0x7c4cfd31 0xe6410000 0x0 0x0 0x4f71c56b 0x5b747188 0x887ce671 0x60741572 0xa275716a 0xb9665ca3 0x23916087 0x5ea0710c 0x2800ff36 0xf0113003 0xc>;
};