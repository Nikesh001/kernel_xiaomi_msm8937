/* Copyright (c) 2015-2016, The Linux Foundation. All rights reserved.
 *
 * This program is free software; you can redistribute it and/or modify
 * it under the terms of the GNU General Public License version 2 and
 * only version 2 as published by the Free Software Foundation.
 *
 * This program is distributed in the hope that it will be useful,
 * but WITHOUT ANY WARRANTY; without even the implied warranty of
 * MERCHANTABILITY or FITNESS FOR A PARTICULAR PURPOSE.  See the
 * GNU General Public License for more details.
 */

&mdss_mdp {
dsi_ili9881c_ebbgDJN_720p_video: qcom,mdss_dsi_ili9881c_ebbgDJN_720p_video {
		qcom,mdss-dsi-panel-name = "ili9881c_HD720p_video_EbbgDJN";
		qcom,mdss-dsi-panel-controller = <&mdss_dsi0>;
		qcom,mdss-dsi-panel-type = "dsi_video_mode";
		qcom,mdss-dsi-panel-destination = "display_1";
		qcom,mdss-dsi-panel-framerate = <0x3c>;
		qcom,mdss-dsi-virtual-channel-id = <0x0>;
		qcom,mdss-dsi-stream = <0x0>;
		qcom,mdss-dsi-panel-width = <0x2d0>;
		qcom,mdss-dsi-panel-height = <0x500>;
		qcom,mdss-pan-physical-width-dimension = <0x3e>;
		qcom,mdss-pan-physical-height-dimension = <0x6e>;
		qcom,mdss-dsi-h-front-porch = <0x72>;
		qcom,mdss-dsi-h-back-porch = <0xb4>;
		qcom,mdss-dsi-h-pulse-width = <0x8>;
		qcom,mdss-dsi-h-sync-skew = <0x0>;
		qcom,mdss-dsi-v-back-porch = <0x12>;
		qcom,mdss-dsi-v-front-porch = <0xa>;
		qcom,mdss-dsi-v-pulse-width = <0x4>;
		qcom,mdss-dsi-h-left-border = <0x0>;
		qcom,mdss-dsi-h-right-border = <0x0>;
		qcom,mdss-dsi-v-top-border = <0x0>;
		qcom,mdss-dsi-v-bottom-border = <0x0>;
		qcom,mdss-dsi-bpp = <0x18>;
		qcom,mdss-dsi-underflow-color = <0x0>;
		qcom,mdss-dsi-border-color = <0x0>;
		qcom,mdss-dsi-on-command = [39 00 00 00 00 00 05 ff 98 81 00 ff 39 00 00 00 00 00 04 ff 98 81 04 39 00 00 00 00 00 04 ff 98 81 04 39 00 00 00 00 00 02 e5 00 39 00 00 00 0a 00 04 ff 98 81 00 39 00 00 00 0a 00 04 ff 98 81 00 39 00 00 00 b4 00 02 11 00 39 00 00 00 00 00 02 29 00 39 00 00 00 0a 00 02 35 00 39 00 00 00 00 00 03 51 0f ff 39 00 00 00 00 00 02 53 2c 39 00 00 00 00 00 02 55 00 39 00 00 00 00 00 02 68 05 39 00 00 00 00 00 03 5e 00 ff 39 00 00 00 00 00 04 ff 98 81 03 39 00 00 00 00 00 04 ff 98 81 03 39 00 00 00 00 00 02 2c 0c 39 00 00 00 00 00 04 ff 98 81 02 39 00 00 00 00 00 04 ff 98 81 02 39 00 00 00 00 00 02 04 16 39 00 00 00 00 00 02 05 22 39 00 00 00 00 00 02 06 40 39 00 00 00 00 00 02 07 04 39 01 00 00 00 00 04 ff 98 81 00 39 01 00 00 00 00 04 ff 98 81 00];
		qcom,mdss-dsi-off-command = <0x39000000 0x4ff 0x98810039 0x0 0x4ff98 0x81000500 0xa00 0x2280005 0x1000096 0x21000>;
		qcom,mdss-dsi-on-command-state = "dsi_hs_mode";
		qcom,mdss-dsi-off-command-state = "dsi_hs_mode";
		qcom,mdss-dsi-panel-warm-command = [39 00 00 00 00 00 04 ff 98 81 01 39 00 00 00 00 00 04 ff 98 81 01 39 00 00 00 00 00 02 a0 00 39 00 00 00 00 00 02 a1 1a 39 00 00 00 00 00 02 a2 29 39 00 00 00 00 00 02 a3 15 39 00 00 00 00 00 02 a4 18 39 00 00 00 00 00 02 a5 2b 39 00 00 00 00 00 02 a6 1f 39 00 00 00 00 00 02 a7 20 39 00 00 00 00 00 02 a8 8d 39 00 00 00 00 00 02 a9 1c 39 00 00 00 00 00 02 aa 28 39 00 00 00 00 00 02 ab 76 39 00 00 00 00 00 02 ac 1a 39 00 00 00 00 00 02 ad 1a 39 00 00 00 00 00 02 ae 4f 39 00 00 00 00 00 02 af 23 39 00 00 00 00 00 02 b0 29 39 00 00 00 00 00 02 b1 4f 39 00 00 00 00 00 02 b2 5d 39 00 00 00 00 00 02 b3 32 39 00 00 00 00 00 02 c0 00 39 00 00 00 00 00 02 c1 1a 39 00 00 00 00 00 02 c2 29 39 00 00 00 00 00 02 c3 15 39 00 00 00 00 00 02 c4 18 39 00 00 00 00 00 02 c5 2b 39 00 00 00 00 00 02 c6 1f 39 00 00 00 00 00 02 c7 20 39 00 00 00 00 00 02 c8 8d 39 00 00 00 00 00 02 c9 1c 39 00 00 00 00 00 02 ca 28 39 00 00 00 00 00 02 cb 76 39 00 00 00 00 00 02 cc 1a 39 00 00 00 00 00 02 cd 1a 39 00 00 00 00 00 02 ce 4f 39 00 00 00 00 00 02 cf 23 39 00 00 00 00 00 02 d0 29 39 00 00 00 00 00 02 d1 4f 39 00 00 00 00 00 02 d2 5d 39 01 00 00 00 00 02 d3 32 39 00 00 00 00 00 04 ff 98 81 05 39 00 00 00 00 00 04 ff 98 81 05 39 00 00 00 00 00 02 85 48 39 00 00 00 00 00 02 00 00 39 00 00 00 00 00 02 01 00 39 00 00 00 00 00 02 02 00 39 00 00 00 00 00 02 03 17 39 00 00 00 00 00 02 04 00 39 00 00 00 00 00 02 05 28 39 00 00 00 00 00 02 06 00 39 00 00 00 00 00 02 07 39 39 00 00 00 00 00 02 08 00 39 00 00 00 00 00 02 09 4c 39 00 00 00 00 00 02 0a 00 39 00 00 00 00 00 02 0b 5f 39 00 00 00 00 00 02 0c 00 39 00 00 00 00 00 02 0d 73 39 00 00 00 00 00 02 0e 00 39 00 00 00 00 00 02 0f 83 39 00 00 00 00 00 02 10 00 39 00 00 00 00 00 02 11 93 39 00 00 00 00 00 02 12 00 39 00 00 00 00 00 02 13 a6 39 00 00 00 00 00 02 14 00 39 00 00 00 00 00 02 15 b6 39 00 00 00 00 00 02 16 00 39 00 00 00 00 00 02 17 c6 39 00 00 00 00 00 02 18 00 39 00 00 00 00 00 02 19 d7 39 00 00 00 00 00 02 1a 00 39 00 00 00 00 00 02 1b e6 39 00 00 00 00 00 02 1c 00 39 00 00 00 00 00 02 1d f7 39 00 00 00 00 00 02 1e 01 39 00 00 00 00 00 02 1f 08 39 00 00 00 00 00 02 20 01 39 00 00 00 00 00 02 21 18 39 00 00 00 00 00 02 22 01 39 00 00 00 00 00 02 23 28 39 00 00 00 00 00 02 24 01 39 00 00 00 00 00 02 25 37 39 00 00 00 00 00 02 26 01 39 00 00 00 00 00 02 27 48 39 00 00 00 00 00 02 28 01 39 00 00 00 00 00 02 29 58 39 00 00 00 00 00 02 2a 01 39 00 00 00 00 00 02 2b 69 39 00 00 00 00 00 02 2c 01 39 00 00 00 00 00 02 2d 79 39 00 00 00 00 00 02 2e 01 39 00 00 00 00 00 02 2f 89 39 00 00 00 00 00 02 30 01 39 00 00 00 00 00 02 31 98 39 00 00 00 00 00 02 32 01 39 00 00 00 00 00 02 33 a8 39 00 00 00 00 00 02 34 01 39 00 00 00 00 00 02 35 b7 39 00 00 00 00 00 02 36 01 39 00 00 00 00 00 02 37 d6 39 00 00 00 00 00 02 38 01 39 00 00 00 00 00 02 39 f5 39 00 00 00 00 00 02 3a 02 39 00 00 00 00 00 02 3b 14 39 00 00 00 00 00 02 3c 02 39 00 00 00 00 00 02 3d 34 39 00 00 00 00 00 02 3e 02 39 00 00 00 00 00 02 3f 53 39 00 00 00 00 00 02 40 02 39 00 00 00 00 00 02 41 71 39 00 00 00 00 00 02 42 02 39 00 00 00 00 00 02 43 91 39 00 00 00 00 00 02 44 02 39 00 00 00 00 00 02 45 ac 39 00 00 00 00 00 02 46 02 39 00 00 00 00 00 02 47 c9 39 00 00 00 00 00 02 48 02 39 00 00 00 00 00 02 49 e6 39 00 00 00 00 00 02 4a 03 39 00 00 00 00 00 02 4b 04 39 00 00 00 00 00 02 4c 03 39 00 00 00 00 00 02 4d 26 39 00 00 00 00 00 02 4e 03 39 00 00 00 00 00 02 4f 43 39 00 00 00 00 00 02 50 03 39 00 00 00 00 00 02 51 63 39 00 00 00 00 00 02 52 03 39 00 00 00 00 00 02 53 81 39 00 00 00 00 00 02 54 03 39 00 00 00 00 00 02 55 a1 39 00 00 00 00 00 02 56 03 39 00 00 00 00 00 02 57 bf 39 00 00 00 00 00 02 58 03 39 00 00 00 00 00 02 59 e5 39 00 00 00 00 00 02 5a 03 39 01 00 00 00 00 02 5b ff 39 00 00 00 00 00 04 ff 98 81 06 39 00 00 00 00 00 04 ff 98 81 06 39 00 00 00 00 00 02 00 00 39 00 00 00 00 00 02 01 00 39 00 00 00 00 00 02 02 00 39 00 00 00 00 00 02 03 12 39 00 00 00 00 00 02 04 00 39 00 00 00 00 00 02 05 24 39 00 00 00 00 00 02 06 00 39 00 00 00 00 00 02 07 33 39 00 00 00 00 00 02 08 00 39 00 00 00 00 00 02 09 42 39 00 00 00 00 00 02 0a 00 39 00 00 00 00 00 02 0b 52 39 00 00 00 00 00 02 0c 00 39 00 00 00 00 00 02 0d 62 39 00 00 00 00 00 02 0e 00 39 00 00 00 00 00 02 0f 72 39 00 00 00 00 00 02 10 00 39 00 00 00 00 00 02 11 80 39 00 00 00 00 00 02 12 00 39 00 00 00 00 00 02 13 8e 39 00 00 00 00 00 02 14 00 39 00 00 00 00 00 02 15 9d 39 00 00 00 00 00 02 16 00 39 00 00 00 00 00 02 17 ad 39 00 00 00 00 00 02 18 00 39 00 00 00 00 00 02 19 bb 39 00 00 00 00 00 02 1a 00 39 00 00 00 00 00 02 1b c8 39 00 00 00 00 00 02 1c 00 39 00 00 00 00 00 02 1d d7 39 00 00 00 00 00 02 1e 00 39 00 00 00 00 00 02 1f e8 39 00 00 00 00 00 02 20 00 39 00 00 00 00 00 02 21 f8 39 00 00 00 00 00 02 22 01 39 00 00 00 00 00 02 23 07 39 00 00 00 00 00 02 24 01 39 00 00 00 00 00 02 25 16 39 00 00 00 00 00 02 26 01 39 00 00 00 00 00 02 27 23 39 00 00 00 00 00 02 28 01 39 00 00 00 00 00 02 29 30 39 00 00 00 00 00 02 2a 01 39 00 00 00 00 00 02 2b 3e 39 00 00 00 00 00 02 2c 01 39 00 00 00 00 00 02 2d 4c 39 00 00 00 00 00 02 2e 01 39 00 00 00 00 00 02 2f 5a 39 00 00 00 00 00 02 30 01 39 00 00 00 00 00 02 31 68 39 00 00 00 00 00 02 32 01 39 00 00 00 00 00 02 33 77 39 00 00 00 00 00 02 34 01 39 00 00 00 00 00 02 35 85 39 00 00 00 00 00 02 36 01 39 00 00 00 00 00 02 37 a0 39 00 00 00 00 00 02 38 01 39 00 00 00 00 00 02 39 bb 39 00 00 00 00 00 02 3a 01 39 00 00 00 00 00 02 3b d6 39 00 00 00 00 00 02 3c 01 39 00 00 00 00 00 02 3d f1 39 00 00 00 00 00 02 3e 02 39 00 00 00 00 00 02 3f 0c 39 00 00 00 00 00 02 40 02 39 00 00 00 00 00 02 41 28 39 00 00 00 00 00 02 42 02 39 00 00 00 00 00 02 43 45 39 00 00 00 00 00 02 44 02 39 00 00 00 00 00 02 45 5e 39 00 00 00 00 00 02 46 02 39 00 00 00 00 00 02 47 78 39 00 00 00 00 00 02 48 02 39 00 00 00 00 00 02 49 95 39 00 00 00 00 00 02 4a 02 39 00 00 00 00 00 02 4b b3 39 00 00 00 00 00 02 4c 02 39 00 00 00 00 00 02 4d cc 39 00 00 00 00 00 02 4e 02 39 00 00 00 00 00 02 4f e6 39 00 00 00 00 00 02 50 03 39 00 00 00 00 00 02 51 00 39 00 00 00 00 00 02 52 03 39 00 00 00 00 00 02 53 1e 39 00 00 00 00 00 02 54 03 39 00 00 00 00 00 02 55 39 39 00 00 00 00 00 02 56 03 39 00 00 00 00 00 02 57 53 39 00 00 00 00 00 02 58 03 39 00 00 00 00 00 02 59 70 39 00 00 00 00 00 02 5a 03 39 01 00 00 00 00 02 5b 8a 39 00 00 00 00 00 04 ff 98 81 07 39 00 00 00 00 00 04 ff 98 81 07 39 00 00 00 00 00 02 00 00 39 00 00 00 00 00 02 01 00 39 00 00 00 00 00 02 02 00 39 00 00 00 00 00 02 03 0e 39 00 00 00 00 00 02 04 00 39 00 00 00 00 00 02 05 24 39 00 00 00 00 00 02 06 00 39 00 00 00 00 00 02 07 34 39 00 00 00 00 00 02 08 00 39 00 00 00 00 00 02 09 41 39 00 00 00 00 00 02 0a 00 39 00 00 00 00 00 02 0b 4c 39 00 00 00 00 00 02 0c 00 39 00 00 00 00 00 02 0d 56 39 00 00 00 00 00 02 0e 00 39 00 00 00 00 00 02 0f 64 39 00 00 00 00 00 02 10 00 39 00 00 00 00 00 02 11 73 39 00 00 00 00 00 02 12 00 39 00 00 00 00 00 02 13 81 39 00 00 00 00 00 02 14 00 39 00 00 00 00 00 02 15 8d 39 00 00 00 00 00 02 16 00 39 00 00 00 00 00 02 17 9b 39 00 00 00 00 00 02 18 00 39 00 00 00 00 00 02 19 aa 39 00 00 00 00 00 02 1a 00 39 00 00 00 00 00 02 1b b8 39 00 00 00 00 00 02 1c 00 39 00 00 00 00 00 02 1d c4 39 00 00 00 00 00 02 1e 00 39 00 00 00 00 00 02 1f d1 39 00 00 00 00 00 02 20 00 39 00 00 00 00 00 02 21 e0 39 00 00 00 00 00 02 22 00 39 00 00 00 00 00 02 23 ef 39 00 00 00 00 00 02 24 00 39 00 00 00 00 00 02 25 fd 39 00 00 00 00 00 02 26 01 39 00 00 00 00 00 02 27 0b 39 00 00 00 00 00 02 28 01 39 00 00 00 00 00 02 29 18 39 00 00 00 00 00 02 2a 01 39 00 00 00 00 00 02 2b 24 39 00 00 00 00 00 02 2c 01 39 00 00 00 00 00 02 2d 31 39 00 00 00 00 00 02 2e 01 39 00 00 00 00 00 02 2f 3d 39 00 00 00 00 00 02 30 01 39 00 00 00 00 00 02 31 4a 39 00 00 00 00 00 02 32 01 39 00 00 00 00 00 02 33 58 39 00 00 00 00 00 02 34 01 39 00 00 00 00 00 02 35 65 39 00 00 00 00 00 02 36 01 39 00 00 00 00 00 02 37 7f 39 00 00 00 00 00 02 38 01 39 00 00 00 00 00 02 39 98 39 00 00 00 00 00 02 3a 01 39 00 00 00 00 00 02 3b b1 39 00 00 00 00 00 02 3c 01 39 00 00 00 00 00 02 3d c9 39 00 00 00 00 00 02 3e 01 39 00 00 00 00 00 02 3f e2 39 00 00 00 00 00 02 40 01 39 00 00 00 00 00 02 41 fa 39 00 00 00 00 00 02 42 02 39 00 00 00 00 00 02 43 14 39 00 00 00 00 00 02 44 02 39 00 00 00 00 00 02 45 2d 39 00 00 00 00 00 02 46 02 39 00 00 00 00 00 02 47 47 39 00 00 00 00 00 02 48 02 39 00 00 00 00 00 02 49 5e 39 00 00 00 00 00 02 4a 02 39 00 00 00 00 00 02 4b 76 39 00 00 00 00 00 02 4c 02 39 00 00 00 00 00 02 4d 90 39 00 00 00 00 00 02 4e 02 39 00 00 00 00 00 02 4f ab 39 00 00 00 00 00 02 50 02 39 00 00 00 00 00 02 51 c4 39 00 00 00 00 00 02 52 02 39 00 00 00 00 00 02 53 da 39 00 00 00 00 00 02 54 02 39 00 00 00 00 00 02 55 f2 39 00 00 00 00 00 02 56 03 39 00 00 00 00 00 02 57 0c 39 00 00 00 00 00 02 58 03 39 00 00 00 00 00 02 59 27 39 00 00 00 00 00 02 5a 03 39 00 00 00 00 00 02 5b 3e 39 00 00 00 00 00 04 ff 98 81 00 39 01 00 00 00 00 04 ff 98 81 00];
		qcom,mdss-dsi-panel-cool-command = [39 00 00 00 00 00 04 ff 98 81 01 39 00 00 00 00 00 04 ff 98 81 01 39 00 00 00 00 00 02 a0 00 39 00 00 00 00 00 02 a1 1c 39 00 00 00 00 00 02 a2 2b 39 00 00 00 00 00 02 a3 15 39 00 00 00 00 00 02 a4 19 39 00 00 00 00 00 02 a5 2c 39 00 00 00 00 00 02 a6 20 39 00 00 00 00 00 02 a7 21 39 00 00 00 00 00 02 a8 95 39 00 00 00 00 00 02 a9 1c 39 00 00 00 00 00 02 aa 27 39 00 00 00 00 00 02 ab 7f 39 00 00 00 00 00 02 ac 1c 39 00 00 00 00 00 02 ad 1d 39 00 00 00 00 00 02 ae 52 39 00 00 00 00 00 02 af 27 39 00 00 00 00 00 02 b0 2b 39 00 00 00 00 00 02 b1 56 39 00 00 00 00 00 02 b2 63 39 00 00 00 00 00 02 b3 32 39 00 00 00 00 00 02 c0 00 39 00 00 00 00 00 02 c1 1c 39 00 00 00 00 00 02 c2 2b 39 00 00 00 00 00 02 c3 15 39 00 00 00 00 00 02 c4 19 39 00 00 00 00 00 02 c5 2c 39 00 00 00 00 00 02 c6 20 39 00 00 00 00 00 02 c7 21 39 00 00 00 00 00 02 c8 95 39 00 00 00 00 00 02 c9 1c 39 00 00 00 00 00 02 ca 27 39 00 00 00 00 00 02 cb 7f 39 00 00 00 00 00 02 cc 1c 39 00 00 00 00 00 02 cd 1d 39 00 00 00 00 00 02 ce 52 39 00 00 00 00 00 02 cf 27 39 00 00 00 00 00 02 d0 2b 39 00 00 00 00 00 02 d1 56 39 00 00 00 00 00 02 d2 63 39 01 00 00 00 00 02 d3 32 39 00 00 00 00 00 04 ff 98 81 05 39 00 00 00 00 00 04 ff 98 81 05 39 00 00 00 00 00 02 85 48 39 00 00 00 00 00 02 00 00 39 00 00 00 00 00 02 01 00 39 00 00 00 00 00 02 02 00 39 00 00 00 00 00 02 03 18 39 00 00 00 00 00 02 04 00 39 00 00 00 00 00 02 05 29 39 00 00 00 00 00 02 06 00 39 00 00 00 00 00 02 07 3a 39 00 00 00 00 00 02 08 00 39 00 00 00 00 00 02 09 4c 39 00 00 00 00 00 02 0a 00 39 00 00 00 00 00 02 0b 5e 39 00 00 00 00 00 02 0c 00 39 00 00 00 00 00 02 0d 71 39 00 00 00 00 00 02 0e 00 39 00 00 00 00 00 02 0f 82 39 00 00 00 00 00 02 10 00 39 00 00 00 00 00 02 11 92 39 00 00 00 00 00 02 12 00 39 00 00 00 00 00 02 13 a4 39 00 00 00 00 00 02 14 00 39 00 00 00 00 00 02 15 b4 39 00 00 00 00 00 02 16 00 39 00 00 00 00 00 02 17 c5 39 00 00 00 00 00 02 18 00 39 00 00 00 00 00 02 19 d6 39 00 00 00 00 00 02 1a 00 39 00 00 00 00 00 02 1b e9 39 00 00 00 00 00 02 1c 00 39 00 00 00 00 00 02 1d fb 39 00 00 00 00 00 02 1e 01 39 00 00 00 00 00 02 1f 08 39 00 00 00 00 00 02 20 01 39 00 00 00 00 00 02 21 18 39 00 00 00 00 00 02 22 01 39 00 00 00 00 00 02 23 28 39 00 00 00 00 00 02 24 01 39 00 00 00 00 00 02 25 37 39 00 00 00 00 00 02 26 01 39 00 00 00 00 00 02 27 46 39 00 00 00 00 00 02 28 01 39 00 00 00 00 00 02 29 57 39 00 00 00 00 00 02 2a 01 39 00 00 00 00 00 02 2b 67 39 00 00 00 00 00 02 2c 01 39 00 00 00 00 00 02 2d 78 39 00 00 00 00 00 02 2e 01 39 00 00 00 00 00 02 2f 88 39 00 00 00 00 00 02 30 01 39 00 00 00 00 00 02 31 97 39 00 00 00 00 00 02 32 01 39 00 00 00 00 00 02 33 a7 39 00 00 00 00 00 02 34 01 39 00 00 00 00 00 02 35 b6 39 00 00 00 00 00 02 36 01 39 00 00 00 00 00 02 37 d5 39 00 00 00 00 00 02 38 01 39 00 00 00 00 00 02 39 f4 39 00 00 00 00 00 02 3a 02 39 00 00 00 00 00 02 3b 13 39 00 00 00 00 00 02 3c 02 39 00 00 00 00 00 02 3d 34 39 00 00 00 00 00 02 3e 02 39 00 00 00 00 00 02 3f 53 39 00 00 00 00 00 02 40 02 39 00 00 00 00 00 02 41 70 39 00 00 00 00 00 02 42 02 39 00 00 00 00 00 02 43 8f 39 00 00 00 00 00 02 44 02 39 00 00 00 00 00 02 45 b0 39 00 00 00 00 00 02 46 02 39 00 00 00 00 00 02 47 ce 39 00 00 00 00 00 02 48 02 39 00 00 00 00 00 02 49 eb 39 00 00 00 00 00 02 4a 03 39 00 00 00 00 00 02 4b 0b 39 00 00 00 00 00 02 4c 03 39 00 00 00 00 00 02 4d 2d 39 00 00 00 00 00 02 4e 03 39 00 00 00 00 00 02 4f 49 39 00 00 00 00 00 02 50 03 39 00 00 00 00 00 02 51 6a 39 00 00 00 00 00 02 52 03 39 00 00 00 00 00 02 53 87 39 00 00 00 00 00 02 54 03 39 00 00 00 00 00 02 55 a7 39 00 00 00 00 00 02 56 03 39 00 00 00 00 00 02 57 c6 39 00 00 00 00 00 02 58 03 39 00 00 00 00 00 02 59 e2 39 00 00 00 00 00 02 5a 00 39 01 00 00 00 00 02 5b 00 39 00 00 00 00 00 04 ff 98 81 06 39 00 00 00 00 00 04 ff 98 81 06 39 00 00 00 00 00 02 00 00 39 00 00 00 00 00 02 01 00 39 00 00 00 00 00 02 02 00 39 00 00 00 00 00 02 03 13 39 00 00 00 00 00 02 04 00 39 00 00 00 00 00 02 05 25 39 00 00 00 00 00 02 06 00 39 00 00 00 00 00 02 07 36 39 00 00 00 00 00 02 08 00 39 00 00 00 00 00 02 09 46 39 00 00 00 00 00 02 0a 00 39 00 00 00 00 00 02 0b 57 39 00 00 00 00 00 02 0c 00 39 00 00 00 00 00 02 0d 67 39 00 00 00 00 00 02 0e 00 39 00 00 00 00 00 02 0f 78 39 00 00 00 00 00 02 10 00 39 00 00 00 00 00 02 11 87 39 00 00 00 00 00 02 12 00 39 00 00 00 00 00 02 13 96 39 00 00 00 00 00 02 14 00 39 00 00 00 00 00 02 15 a7 39 00 00 00 00 00 02 16 00 39 00 00 00 00 00 02 17 b7 39 00 00 00 00 00 02 18 00 39 00 00 00 00 00 02 19 c6 39 00 00 00 00 00 02 1a 00 39 00 00 00 00 00 02 1b d5 39 00 00 00 00 00 02 1c 00 39 00 00 00 00 00 02 1d e6 39 00 00 00 00 00 02 1e 00 39 00 00 00 00 00 02 1f f7 39 00 00 00 00 00 02 20 01 39 00 00 00 00 00 02 21 08 39 00 00 00 00 00 02 22 01 39 00 00 00 00 00 02 23 17 39 00 00 00 00 00 02 24 01 39 00 00 00 00 00 02 25 25 39 00 00 00 00 00 02 26 01 39 00 00 00 00 00 02 27 33 39 00 00 00 00 00 02 28 01 39 00 00 00 00 00 02 29 42 39 00 00 00 00 00 02 2a 01 39 00 00 00 00 00 02 2b 51 39 00 00 00 00 00 02 2c 01 39 00 00 00 00 00 02 2d 61 39 00 00 00 00 00 02 2e 01 39 00 00 00 00 00 02 2f 70 39 00 00 00 00 00 02 30 01 39 00 00 00 00 00 02 31 7f 39 00 00 00 00 00 02 32 01 39 00 00 00 00 00 02 33 8e 39 00 00 00 00 00 02 34 01 39 00 00 00 00 00 02 35 9c 39 00 00 00 00 00 02 36 01 39 00 00 00 00 00 02 37 b9 39 00 00 00 00 00 02 38 01 39 00 00 00 00 00 02 39 d6 39 00 00 00 00 00 02 3a 01 39 00 00 00 00 00 02 3b f4 39 00 00 00 00 00 02 3c 02 39 00 00 00 00 00 02 3d 13 39 00 00 00 00 00 02 3e 02 39 00 00 00 00 00 02 3f 32 39 00 00 00 00 00 02 40 02 39 00 00 00 00 00 02 41 4f 39 00 00 00 00 00 02 42 02 39 00 00 00 00 00 02 43 6a 39 00 00 00 00 00 02 44 02 39 00 00 00 00 00 02 45 87 39 00 00 00 00 00 02 46 02 39 00 00 00 00 00 02 47 a6 39 00 00 00 00 00 02 48 02 39 00 00 00 00 00 02 49 c4 39 00 00 00 00 00 02 4a 02 39 00 00 00 00 00 02 4b de 39 00 00 00 00 00 02 4c 02 39 00 00 00 00 00 02 4d fb 39 00 00 00 00 00 02 4e 03 39 00 00 00 00 00 02 4f 1a 39 00 00 00 00 00 02 50 03 39 00 00 00 00 00 02 51 37 39 00 00 00 00 00 02 52 03 39 00 00 00 00 00 02 53 53 39 00 00 00 00 00 02 54 03 39 00 00 00 00 00 02 55 72 39 00 00 00 00 00 02 56 03 39 00 00 00 00 00 02 57 8e 39 00 00 00 00 00 02 58 03 39 00 00 00 00 00 02 59 ab 39 00 00 00 00 00 02 5a 03 39 01 00 00 00 00 02 5b c9 39 00 00 00 00 00 04 ff 98 81 07 39 00 00 00 00 00 04 ff 98 81 07 39 00 00 00 00 00 02 00 00 39 00 00 00 00 00 02 01 00 39 00 00 00 00 00 02 02 00 39 00 00 00 00 00 02 03 0d 39 00 00 00 00 00 02 04 00 39 00 00 00 00 00 02 05 22 39 00 00 00 00 00 02 06 00 39 00 00 00 00 00 02 07 35 39 00 00 00 00 00 02 08 00 39 00 00 00 00 00 02 09 46 39 00 00 00 00 00 02 0a 00 39 00 00 00 00 00 02 0b 54 39 00 00 00 00 00 02 0c 00 39 00 00 00 00 00 02 0d 61 39 00 00 00 00 00 02 0e 00 39 00 00 00 00 00 02 0f 71 39 00 00 00 00 00 02 10 00 39 00 00 00 00 00 02 11 82 39 00 00 00 00 00 02 12 00 39 00 00 00 00 00 02 13 91 39 00 00 00 00 00 02 14 00 39 00 00 00 00 00 02 15 a2 39 00 00 00 00 00 02 16 00 39 00 00 00 00 00 02 17 b2 39 00 00 00 00 00 02 18 00 39 00 00 00 00 00 02 19 c1 39 00 00 00 00 00 02 1a 00 39 00 00 00 00 00 02 1b d0 39 00 00 00 00 00 02 1c 00 39 00 00 00 00 00 02 1d e2 39 00 00 00 00 00 02 1e 00 39 00 00 00 00 00 02 1f f2 39 00 00 00 00 00 02 20 01 39 00 00 00 00 00 02 21 03 39 00 00 00 00 00 02 22 01 39 00 00 00 00 00 02 23 12 39 00 00 00 00 00 02 24 01 39 00 00 00 00 00 02 25 20 39 00 00 00 00 00 02 26 01 39 00 00 00 00 00 02 27 2e 39 00 00 00 00 00 02 28 01 39 00 00 00 00 00 02 29 3b 39 00 00 00 00 00 02 2a 01 39 00 00 00 00 00 02 2b 4b 39 00 00 00 00 00 02 2c 01 39 00 00 00 00 00 02 2d 5a 39 00 00 00 00 00 02 2e 01 39 00 00 00 00 00 02 2f 69 39 00 00 00 00 00 02 30 01 39 00 00 00 00 00 02 31 78 39 00 00 00 00 00 02 32 01 39 00 00 00 00 00 02 33 87 39 00 00 00 00 00 02 34 01 39 00 00 00 00 00 02 35 95 39 00 00 00 00 00 02 36 01 39 00 00 00 00 00 02 37 b1 39 00 00 00 00 00 02 38 01 39 00 00 00 00 00 02 39 ce 39 00 00 00 00 00 02 3a 01 39 00 00 00 00 00 02 3b ec 39 00 00 00 00 00 02 3c 02 39 00 00 00 00 00 02 3d 0a 39 00 00 00 00 00 02 3e 02 39 00 00 00 00 00 02 3f 29 39 00 00 00 00 00 02 40 02 39 00 00 00 00 00 02 41 47 39 00 00 00 00 00 02 42 02 39 00 00 00 00 00 02 43 61 39 00 00 00 00 00 02 44 02 39 00 00 00 00 00 02 45 7d 39 00 00 00 00 00 02 46 02 39 00 00 00 00 00 02 47 9b 39 00 00 00 00 00 02 48 02 39 00 00 00 00 00 02 49 ba 39 00 00 00 00 00 02 4a 02 39 00 00 00 00 00 02 4b d4 39 00 00 00 00 00 02 4c 02 39 00 00 00 00 00 02 4d ef 39 00 00 00 00 00 02 4e 03 39 00 00 00 00 00 02 4f 0c 39 00 00 00 00 00 02 50 03 39 00 00 00 00 00 02 51 2c 39 00 00 00 00 00 02 52 03 39 00 00 00 00 00 02 53 46 39 00 00 00 00 00 02 54 03 39 00 00 00 00 00 02 55 64 39 00 00 00 00 00 02 56 03 39 00 00 00 00 00 02 57 80 39 00 00 00 00 00 02 58 03 39 00 00 00 00 00 02 59 9e 39 00 00 00 00 00 02 5a 03 39 00 00 00 00 00 02 5b ba 39 00 00 00 00 00 04 ff 98 81 00 39 01 00 00 00 00 04 ff 98 81 00];
		qcom,mdss-dsi-panel-nature-command = [39 01 00 00 00 00 04 ff 98 81 04 39 00 00 00 00 00 04 ff 98 81 04 39 00 00 00 00 00 02 e5 02 39 00 00 00 00 00 04 ff 98 81 00 39 01 00 00 00 00 04 ff 98 81 00 39 01 00 00 00 00 02 11 00 39 01 00 00 00 00 04 ff 98 81 03 39 01 00 00 00 00 04 ff 98 81 03 39 01 00 00 00 00 02 2c 0c 39 01 00 00 00 00 04 ff 98 81 00 39 01 00 00 00 00 04 ff 98 81 00];
		qcom,mdss-dsi-panel-gamma-command-state = "dsi_hs_mode";
		qcom,mdss-dsi-init-last;
		qcom,mdss-dsi-panel-ce-std-command = [39 01 00 00 00 00 04 ff 98 81 02 39 01 00 00 00 00 04 ff 98 81 02 39 01 00 00 00 00 02 10 06 39 01 00 00 00 00 04 ff 98 81 00 39 01 00 00 00 00 04 ff 98 81 00 39 01 00 00 00 00 02 55 00];
		qcom,mdss-dsi-panel-ce-vivid-command = [39 00 00 00 00 00 04 ff 98 81 02 39 00 00 00 00 00 04 ff 98 81 02 39 00 00 00 00 00 02 10 16 39 00 00 00 00 00 02 68 02 39 00 00 00 00 00 02 69 03 39 00 00 00 00 00 02 6a 03 39 00 00 00 00 00 02 6b 03 39 00 00 00 00 00 02 6c 00 39 00 00 00 00 00 02 6d 04 39 00 00 00 00 00 02 6e 04 39 00 00 00 00 00 02 6f 05 39 00 00 00 00 00 02 70 05 39 00 00 00 00 00 02 71 05 39 00 00 00 00 00 02 72 03 39 00 00 00 00 00 02 73 01 39 00 00 00 00 00 02 74 01 39 00 00 00 00 00 02 75 02 39 00 00 00 00 00 02 76 04 39 00 00 00 00 00 02 77 02 39 00 00 00 00 00 02 78 02 39 00 00 00 00 00 02 79 02 39 00 00 00 00 00 02 7a 02 39 00 00 00 00 00 02 7b 02 39 00 00 00 00 00 02 7c 02 39 00 00 00 00 00 02 7d 02 39 00 00 00 00 00 02 7e 02 39 00 00 00 00 00 02 7f 02 39 00 00 00 00 00 04 ff 98 81 00 39 00 00 00 00 00 04 ff 98 81 00 39 01 00 00 00 00 02 55 01];
		qcom,mdss-dsi-panel-ce-command-state = "dsi_hs_mode";
		qcom,mdss-dsi-h-sync-pulse = <0x1>;
		qcom,mdss-dsi-traffic-mode = "burst_mode";
		qcom,mdss-dsi-bllp-eof-power-mode;
		qcom,mdss-dsi-bllp-power-mode;
		qcom,mdss-dsi-lane-0-state;
		qcom,mdss-dsi-lane-1-state;
		qcom,mdss-dsi-lane-2-state;
		qcom,mdss-dsi-lane-3-state;
		qcom,mdss-dsi-panel-timings = <0x8b1e1400 0x44481830 0x19030400>;
		qcom,mdss-dsi-t-clk-post = <0x4>;
		qcom,mdss-dsi-t-clk-pre = <0x1c>;
		qcom,mdss-dsi-bl-min-level = <0x1>;
		qcom,mdss-dsi-bl-max-level = <0xfff>;
		qcom,mdss-dsi-dma-trigger = "trigger_sw";
		qcom,mdss-dsi-mdp-trigger = "none";
		qcom,mdss-dsi-bl-pmic-control-type = "bl_ctrl_wled";
		qcom,mdss-dsi-lp11-init;
		qcom,mdss-dsi-init-delay-us = <0x4e20>;
		qcom,mdss-dsi-reset-sequence = <0x1 0x5 0x0 0xa 0x1 0x50>;
		qcom,mdss-night-brightness = <0x8 0x1a 0x2e 0x44>;
		qcom,esd-check-enabled;
		qcom,mdss-dsi-panel-status-command = [06 01 00 01 05 00 02 0a 08 06 01 00 01 05 00 02 0d 08];
		qcom,mdss-dsi-panel-status-command-state = "dsi_hs_mode";
		qcom,mdss-dsi-panel-status-check-mode = "reg_read";
		qcom,mdss-dsi-panel-status-valid-params = <0x1 0x1>;
		qcom,mdss-dsi-panel-status-value = <0x9c 0x0>;
		qcom,mdss-dsi-panel-status-read-length = <0x1 0x1>;
		qcom,panel-supply-entries = <0x183>;
	};
};