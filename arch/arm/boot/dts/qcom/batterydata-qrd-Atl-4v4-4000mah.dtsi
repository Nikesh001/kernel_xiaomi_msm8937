qcom,2312470_wingtech_a12atl_4000mah_averaged_masterslave_feb1st2016 {
	qcom,max-voltage-uv = <0x432380>;
	qcom,nom-batt-capacity-mah = <0x1004>;
	qcom,batt-id-kohm = <0x44>;
	qcom,battery-beta = <0x1036>;
	qcom,battery-type = "qrd_msm8937_Atl_4100mah";
	qcom,chg-rslow-comp-c1 = <0x2df2ce>;
	qcom,chg-rslow-comp-c2 = <0x3fddee>;
	qcom,chg-rs-to-rslow = <0xebd75>;
	qcom,chg-rslow-comp-thr = <0xa3>;
	qcom,checksum = <0x90c2>;
	qcom,gui-version = "PMI8950GUI - 2.0.0.15";
	qcom,fg-profile-data = <0xe183cd7c 0xfa80de76 0x69836b75 0x2b8a2495 0x1282869a 0x72bd12ca 0x5611ec83 0xb57cc880 0x55765a83 0xa6605e81 0xed8d5482 0x9999e9bc 0xcdc9540e 0x6510a458 0x1470eefc 0xf36443d 0xfd2e0000 0x603f4433 0x353f0000 0x0 0x0 0xf76bda6a 0x5f63d880 0xeb6f3c62 0xb5576b78 0xdf6eae60 0x8a845ba3 0x17a8632d 0x65a0710c 0x2800ff36 0xf0113003 0xc>;
};