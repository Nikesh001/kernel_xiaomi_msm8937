/* Copyright (c) 2015-2016, The Linux Foundation. All rights reserved.
 *
 * This program is free software; you can redistribute it and/or modify
 * it under the terms of the GNU General Public License version 2 and
 * only version 2 as published by the Free Software Foundation.
 *
 * This program is distributed in the hope that it will be useful,
 * but WITHOUT ANY WARRANTY; without even the implied warranty of
 * MERCHANTABILITY or FITNESS FOR A PARTICULAR PURPOSE.  See the
 * GNU General Public License for more details.
 */

&mdss_mdp {
dsi_hx8394f_boe_720p_video: qcom,mdss_dsi_hx8394f_boe_720p_video {
		qcom,mdss-dsi-panel-name = "hx8394F_HD720p_video_BOE";
		qcom,mdss-dsi-panel-controller = <&mdss_dsi0>;
		qcom,mdss-dsi-panel-type = "dsi_video_mode";
		qcom,mdss-dsi-panel-destination = "display_1";
		qcom,mdss-dsi-panel-framerate = <0x3c>;
		qcom,mdss-dsi-virtual-channel-id = <0x0>;
		qcom,mdss-dsi-stream = <0x0>;
		qcom,mdss-dsi-panel-width = <0x2d0>;
		qcom,mdss-dsi-panel-height = <0x500>;
		qcom,mdss-dsi-h-front-porch = <0xa0>;
		qcom,mdss-dsi-h-back-porch = <0xa0>;
		qcom,mdss-dsi-h-pulse-width = <0x18>;
		qcom,mdss-dsi-h-sync-skew = <0x0>;
		qcom,mdss-dsi-v-back-porch = <0xc>;
    	qcom,mdss-dsi-v-front-porch = <0xf>;
		qcom,mdss-dsi-v-pulse-width = <0x4>;
		qcom,mdss-dsi-h-left-border = <0x0>;
		qcom,mdss-dsi-h-right-border = <0x0>;
		qcom,mdss-dsi-v-top-border = <0x0>;
		qcom,mdss-dsi-v-bottom-border = <0x0>;
		qcom,mdss-dsi-bpp = <0x18>;
		qcom,mdss-dsi-color-order = "rgb_swap_rgb";
		qcom,mdss-dsi-underflow-color = <0x0>;
		qcom,mdss-dsi-border-color = <0x0>;
		qcom,mdss-dsi-on-command = [39 01 00 00 00 00 04 b9 ff 83 94 05 01 00 00 78 00 02 11 00 05 01 00 00 14 00 02 29 00 39 01 00 00 00 00 02 51 ff 39 01 00 00 05 00 0a c9 13 00 13 1e 31 1e 00 91 00 39 01 00 00 05 00 02 55 00 39 01 00 00 00 00 02 53 2c];
		qcom,mdss-dsi-off-command = [05 01 00 00 32 00 02 28 00 05 01 00 00 78 00 02 10 00];
		qcom,mdss-dsi-on-command-state = "dsi_lp_mode";
		qcom,mdss-dsi-off-command-state = "dsi_hs_mode";
		qcom,mdss-dsi-panel-warm-command = [39 01 00 00 01 00 3b e0 07 08 09 0d 10 14 16 13 24 36 48 4a 58 6f 76 80 97 a5 a8 b5 c6 62 63 68 6f 72 78 7f 7f 00 02 08 0d 0c 0e 0f 10 24 36 48 4a 58 6f 78 82 99 a4 a0 b1 c0 5e 5e 64 6b 6c 73 7f 7f 39 01 00 00 01 00 02 bd 00 39 01 00 00 01 00 2c c1 01 00 0c 18 24 30 3a 43 4a 52 59 5f 66 6d 74 7b 83 8a 91 99 a0 a7 ae b5 bc c3 ca d1 d9 e0 e7 ef f7 ff 15 b3 59 b8 1e 00 ac 63 c0 39 01 00 00 01 00 02 bd 01 39 01 00 00 01 00 2b c1 00 0b 16 21 2c 36 3e 46 4d 54 5a 60 66 6c 73 79 7f 86 8d 93 9b a0 a6 ad b3 b9 bf c6 cd d3 da e0 e6 06 9d 40 21 e3 3c 6e 62 c0 39 01 00 00 01 00 02 bd 02 39 01 00 00 01 00 2b c1 00 0a 14 1e 28 32 3b 43 4a 51 57 5d 62 69 6f 75 7b 82 88 8f 95 9c a2 a7 ae b4 ba c0 c6 cd d2 d9 de 16 be 95 db cd e3 01 8c c0 39 01 00 00 01 00 02 bd 00];
		qcom,mdss-dsi-panel-cool-command = [39 01 00 00 01 00 3b e0 07 08 09 0d 10 14 16 13 24 36 48 4a 58 6f 76 80 97 a5 a8 b5 c6 62 63 68 6f 72 78 7f 7f 00 02 08 0d 0c 0e 11 10 24 36 48 4a 58 6f 78 82 99 a4 a0 b1 c0 5e 5e 64 6b 6c 73 7f 7f 39 01 00 00 01 00 02 bd 00 39 01 00 00 01 00 2c c1 01 00 0a 14 1e 28 32 3c 43 4b 52 59 5f 66 6d 74 7b 82 8a 92 9a a0 a8 af b7 bd c7 ce d5 dd e6 ee f7 ff 16 e3 11 59 a4 8d c3 84 c0 39 01 00 00 01 00 02 bd 01 39 01 00 00 01 00 2b c1 00 0a 13 1d 27 31 3b 43 4a 51 57 5e 64 6b 72 79 80 87 8f 97 9e a4 ab b3 ba c1 c9 d0 d7 df e6 ee f6 0f f0 1d aa b4 7c 01 c8 00 39 01 00 00 01 00 02 bd 02 39 01 00 00 01 00 2b c1 00 0a 13 1d 27 32 3c 44 4c 53 5a 60 68 6f 76 7d 85 8c 94 9c a3 aa b2 b9 c0 c8 d0 d8 df e7 ee f6 fe 0e 56 27 1b 7e b5 f8 8b 00 39 01 00 00 01 00 02 bd 00];
		qcom,mdss-dsi-panel-nature-command = [39 01 00 00 01 00 3b e0 07 08 09 0d 10 14 16 13 24 36 48 4a 58 6f 76 80 97 a5 a8 b5 c6 62 63 68 6f 72 78 7f 7f 00 02 08 0d 0c 0e 0f 10 24 36 48 4a 58 6f 78 82 99 a4 a0 b1 c0 5e 5e 64 6b 6c 73 7f 7f 39 01 00 00 01 00 02 bd 00 39 01 00 00 01 00 2c c1 01 00 0a 14 1e 28 32 3b 43 4a 52 58 5f 65 6d 74 7b 82 8a 92 99 a1 a8 ae b6 be c5 cd d6 dc e5 ed f6 ff 15 8f c9 c5 97 4f 3c cb c0 39 01 00 00 01 00 02 bd 01 39 01 00 00 01 00 2b c1 00 09 13 1d 26 30 39 41 48 4f 55 5c 62 68 6f 76 7d 84 8b 92 9a a0 a7 ae b5 bc c3 cb d2 d9 e0 e7 ef 24 85 5c 39 07 79 44 1a 80 39 01 00 00 01 00 02 bd 02 39 01 00 00 01 00 2b c1 00 09 12 1b 24 2e 38 41 48 4f 56 5c 62 69 70 77 7e 85 8c 93 9b a2 a8 af b6 bd c4 cc d3 da e1 e8 f0 15 7c 62 a9 1b 8b 4c 2e 00 39 01 00 00 01 00 02 bd 00];
		qcom,mdss-dsi-panel-gamma-command-state = "dsi_lp_mode";
		qcom,mdss-dsi-panel-ce-std-command = [39 01 00 00 05 00 02 55 00 39 01 00 00 0a 00 03 e4 01 00];
		qcom,mdss-dsi-panel-ce-vivid-command = [39 01 00 00 05 00 02 55 11 39 01 00 00 05 00 03 e4 01 42 39 01 00 00 01 00 20 e5 00 00 0b 08 01 00 00 00 00 00 00 05 1d 19 1f 05 ed 09 20 00 00 04 0b 02 01 08 08 07 02 04 02 39 01 00 00 01 00 16 e6 00 08 00 05 05 10 10 10 20 20 20 10 10 10 10 10 03 a0 01 0f 11];
		qcom,mdss-dsi-panel-ce-command-state = "dsi_lp_mode";
		qcom,mdss-dsi-h-sync-pulse = <0x1>;
		qcom,mdss-dsi-traffic-mode = "burst_mode";
		qcom,mdss-dsi-lane-map = "lane_map_0123";
		qcom,mdss-dsi-bllp-eof-power-mode;
		qcom,mdss-dsi-bllp-power-mode;
		qcom,mdss-dsi-lane-0-state;
		qcom,mdss-dsi-lane-1-state;
		qcom,mdss-dsi-lane-2-state;
		qcom,mdss-dsi-lane-3-state;
		qcom,mdss-dsi-panel-timings = <0x8c1e1400 0x46481a22 0x18030400>;
		qcom,mdss-dsi-t-clk-post = <0x4>;
		qcom,mdss-dsi-t-clk-pre = <0x1c>;
		qcom,esd-check-enabled;
		qcom,mdss-dsi-panel-status-command = <0x6010001 0x50001d9 0x6010001 0x5000109>;
		qcom,mdss-dsi-panel-status-command-num = <0x2>;
		qcom,mdss-dsi-panel-status-command-state = "dsi_hs_mode";
		qcom,mdss-dsi-panel-status-check-mode = "reg_read";
		qcom,mdss-dsi-panel-status-read-length = <0x4 0x4>;
		qcom,mdss-dsi-panel-status-valid-params = <0x1 0x3>;
		qcom,mdss-dsi-panel-status-value = <0x80 0x80 0x73 0x4 0x80 0x80 0x73 0x4>;
		qcom,mdss-dsi-bl-min-level = <0x1>;
		qcom,mdss-dsi-bl-max-level = <0xfff>;
		qcom,mdss-dsi-dma-trigger = "trigger_sw";
		qcom,mdss-dsi-mdp-trigger = "none";
		qcom,mdss-dsi-bl-pmic-control-type = "bl_ctrl_wled";
		qcom,mdss-dsi-reset-sequence = <0x1 0x32 0x0 0x14 0x1 0x5>;
		qcom,mdss-pan-physical-width-dimension = <0x3e>;
		qcom,mdss-pan-physical-height-dimension = <0x6e>;
		qcom,mdss-dsi-lp11-init;
		qcom,mdss-dsi-init-delay-us = <0xc350>;
		qcom,mdss-night-brightness = <0x7 0x19 0x2d 0x43>;
		qcom,mdss-dsi-tx-eot-append;
		qcom,panel-supply-entries = <0x183>;
    };
};